/*
 * Copyright (c) 2024 The ZMK Contributors
 * SPDX-License-Identifier: MIT
 * 
 * Common trackball input processor configurations for Charybdis keyboard
 * This file defines the standard processing for snipe, scroll, and move modes
 * 
 * Usage: Include this file and define CHARYBDIS_TRACKBALL_LISTENER macro
 * Example:
 *   #define CHARYBDIS_TRACKBALL_LISTENER snipe { layers = <SNIPING>; input-processors = <&zip_xy_scaler 1 3>; }; scroll { layers = <SCROLL>; input-processors = <&zip_xy_transform (INPUT_TRANSFORM_Y_INVERT)>, <&zip_xy_scaler 1 20>, <&zip_xy_to_scroll_mapper>; }; move { layers = <BASE POINTER>; input-processors = <&zip_xy_scaler 7 6>; };
 */

#include "charybdis_layers.h"
#include <dt-bindings/zmk/input_transform.h>
#include <input/processors.dtsi>

// Time in milliseconds that the POINTER layer stays active after the last
// trackball movement, when it was auto-enabled by the temp-layer input processor.
// Tune this value to change how long you have to click/scroll before the layer
// turns itself off again.
#define POINTER_TEMP_LAYER_TIMEOUT_MS 5000

// Minimum time in milliseconds that must pass after the last key press before a
// trackball movement is allowed to auto-enable the POINTER layer. This prevents
// accidental trackball touches while typing from triggering the auto layer.
#define POINTER_PRIOR_IDLE_MS 2000

// Standard trackball processing configuration
// Can be used in both standalone (trackball_listener) and dongle mode (input_split_listener)
#define CHARYBDIS_TRACKBALL_PROCESSORS \
    snipe { \
        layers = <SNIPING>; \
        input-processors = <&zip_xy_scaler 1 3>; \
    }; \
    \
    scroll { \
        layers = <SCROLL>; \
        input-processors = <&zip_xy_transform (INPUT_TRANSFORM_Y_INVERT)>, <&zip_xy_scaler 1 40>, <&zip_xy_to_scroll_mapper>; \
    }; \
    \
    move { \
        layers = <BASE POINTER>; \
        input-processors = <&zip_temp_layer POINTER POINTER_TEMP_LAYER_TIMEOUT_MS>, <&zip_xy_scaler 3 2>; \
    };

// Configure the shared temp-layer input processor: do not auto-enable the
// POINTER layer from trackball movement if a key has been pressed within the
// last POINTER_PRIOR_IDLE_MS milliseconds (typing guard).
&zip_temp_layer {
    require-prior-idle-ms = <POINTER_PRIOR_IDLE_MS>;
};

